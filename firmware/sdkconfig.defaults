## firmware/sdkconfig.defaults
```kconfig
CONFIG_IDF_TARGET="esp32s3"

# 16MB flash, octal PSRAM (N16R8). PSRAM at 40MHz — 80MHz is unreliable
# on early S3 silicon (rev v0.2 seen on bench). HUB75 address pins were
# moved into the 1-21 range so they don't clash with PSRAM (GPIO 26-37).
CONFIG_ESPTOOLPY_FLASHSIZE_16MB=y
CONFIG_ESPTOOLPY_FLASHMODE_QIO=y
CONFIG_ESPTOOLPY_FLASHFREQ_80M=y
CONFIG_SPIRAM=y
CONFIG_SPIRAM_MODE_OCT=y
CONFIG_SPIRAM_SPEED_40M=y

# Custom partition table — dual OTA + LittleFS
CONFIG_PARTITION_TABLE_CUSTOM=y
CONFIG_PARTITION_TABLE_CUSTOM_FILENAME="partitions.csv"

# Console on USB-CDC so a fresh board prints without a UART adapter
CONFIG_ESP_CONSOLE_USB_SERIAL_JTAG=y

# Bigger main task stack — HUB75 setup + JSON parsing will need it
CONFIG_ESP_MAIN_TASK_STACK_SIZE=8192

# FreeRTOS tick at 1kHz for smoother scene timing
CONFIG_FREERTOS_HZ=1000
```
